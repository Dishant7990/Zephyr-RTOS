## CMakeLists.txt
```
cmake_minimum_required(VERSION 3.20.0)

find_package(Zephyr REQUIRED HINTS $ENV{ZEPHYR_BASE})
project(00_Hello_world)

target_sources(app PRIVATE src/main.c)
```

## prj.conf
```kconfig
CONFIG_LOG=y
CONFIG_UART_CONSOLE=y
CONFIG_CONSOLE=y

# Ensure an MCUBoot-compatible binary is generated
CONFIG_BOOTLOADER_MCUBOOT=y

# Enable Flash operation
CONFIG_FLASH=y
CONFIG_FLASH_MAP=y
CONFIG_STREAM_FLASH=y

# Some command handlers require a large stack
CONFIG_SYSTEM_WORKQUEUE_STACK_SIZE=4096
CONFIG_MAIN_STACK_SIZE=2048

# Enable statistics and statistic names
CONFIG_STATS=y
CONFIG_STATS_NAMES=y

# Required by the `taskstat` command.
CONFIG_THREAD_MONITOR=y

# Support for taskstat command
CONFIG_MCUMGR_GRP_OS_TASKSTAT=y

# Enable most core commands
CONFIG_NET_BUF=y
CONFIG_ZCBOR=y
CONFIG_CRC=y

CONFIG_IMG_MANAGER=y
CONFIG_MCUMGR_GRP_IMG=y
CONFIG_MCUMGR_GRP_OS=y
CONFIG_MCUMGR_GRP_STAT=y
```

## overlay-serial.conf
```kconfig
# Enable console & UART mcumgr transport
CONFIG_CONSOLE=y
CONFIG_BASE64=y
CONFIG_MCUMGR_TRANSPORT_UART=y

# Ensure uart driver/console support (some boards already enable)
CONFIG_UART_CONSOLE=y
```

## boards/esp32s3_devkitc_procpu.overlay
```dts
/ {
    chosen {
        /* Change to &uart1 if needed */
        zephyr,uart-mcumgr = &uart0;
    };
};

&uart0 {
    current-speed = <1000000>;
    status = "okay";
};
```

## src/main.c
```c
#include <zephyr/kernel.h>
#include <zephyr/logging/log.h>

LOG_MODULE_REGISTER(mcuboot, LOG_LEVEL_INF);

int main(void) {
    while(1) {
        LOG_INF("Hello world.. mcuboot\n");
        k_sleep(K_SECONDS(2));
    }

    return 0;
}
```
